## templates/lvgl-ui-template/main/Kconfig.projbuild
```kconfig
menu "LVGL UI Template Configuration"

    choice APP_BOARD
        prompt "Target board"
        default APP_BOARD_ESP32S3_BOX3
        help
            Select the target development board.
            After changing this option, run "idf.py fullclean" then rebuild
            so the correct board BSP component is linked.

        config APP_BOARD_ESP32S3_BOX3
            bool "ESP32-S3-BOX-3  (320x240 SPI)"
        config APP_BOARD_ESP32S3_LCD_EV_BOARD
            bool "ESP32-S3-LCD-EV-BOARD-2  (480x480 or 800x480 RGB)"
        config APP_BOARD_CUSTOM
            bool "Custom board (user-defined)"
    endchoice

    config APP_BOARD_CUSTOM_NAME
        string "Custom board directory name"
        default "custom"
        depends on APP_BOARD_CUSTOM
        help
            Name of the subdirectory under components/boards/ that contains
            your board implementation.  The directory must provide
            CMakeLists.txt, idf_component.yml (if it has external BSP deps),
            and src/board_display.c + src/board_touch.c implementing the
            hal_display_create / hal_touch_create functions declared in
            board_hal/hal_display.h and board_hal/hal_touch.h.
            See components/boards/custom/ for a ready-to-copy skeleton.

    menu "Wi-Fi"

        config APP_WIFI_SSID
            string "Wi-Fi SSID"
            default ""
            help
                Leave empty to disable Wi-Fi (and the debug screenshot /
                synthetic input servers, which require it).

        config APP_WIFI_PASSWORD
            string "Wi-Fi Password"
            default ""

    endmenu

    menu "Debug"

        config DEBUG_SCREENSHOT_ENABLED
            bool "Enable on-demand LVGL screenshot server (Wi-Fi)"
            default y
            help
                Runs a small TCP server that, on request from a PC tool,
                captures the current LVGL screen via lv_snapshot and sends
                it as raw RGB565 pixels. Requires Wi-Fi (APP_WIFI_SSID).

        config DEBUG_SCREENSHOT_PORT
            int "Screenshot server TCP port"
            default 3333
            depends on DEBUG_SCREENSHOT_ENABLED

        config DEBUG_INPUT_ENABLED
            bool "Enable on-demand synthetic touch input server (Wi-Fi)"
            default y
            help
                Runs a small TCP server that, on request from a PC tool,
                injects synthetic LVGL pointer (touch) events — tap, press,
                release, move — without involving the I2C touch controller.
                Requires Wi-Fi (APP_WIFI_SSID).

        config DEBUG_INPUT_PORT
            int "Synthetic touch input server TCP port"
            default 3334
            depends on DEBUG_INPUT_ENABLED

    endmenu

endmenu
```

## templates/lvgl-ui-template/sdkconfig.defaults
```kconfig
CONFIG_ESPTOOLPY_FLASHSIZE_16MB=y
CONFIG_PARTITION_TABLE_CUSTOM=y
CONFIG_PARTITION_TABLE_CUSTOM_FILENAME="partitions.csv"
CONFIG_ESPTOOLPY_FLASHMODE_QIO=y
CONFIG_ESPTOOLPY_FLASHFREQ_80M=y

CONFIG_SPIRAM=y
CONFIG_SPIRAM_MODE_OCT=y
CONFIG_SPIRAM_SPEED_80M=y
CONFIG_SPIRAM_USE_MALLOC=y
CONFIG_SPIRAM_MALLOC_ALWAYSINTERNAL=16384

CONFIG_ESP_TASK_WDT_TIMEOUT_S=30
CONFIG_MAIN_TASK_STACK_SIZE=8192

CONFIG_LOG_DEFAULT_LEVEL_INFO=y
CONFIG_LOG_MAXIMUM_LEVEL_DEBUG=y

CONFIG_FREERTOS_HZ=1000

CONFIG_LV_FONT_MONTSERRAT_14=y
CONFIG_LV_FONT_MONTSERRAT_16=y
CONFIG_LV_FONT_MONTSERRAT_24=y

# Enable LVGL snapshot API for the debug screenshot tool
CONFIG_LV_USE_SNAPSHOT=y

# Debug screenshot + synthetic touch input servers (Wi-Fi)
CONFIG_DEBUG_SCREENSHOT_ENABLED=y
CONFIG_DEBUG_INPUT_ENABLED=y
```
